// import the PDM (microphone) and the ARM CMSIS DSP library
#include <PDM.h>
#include <arm_math.h>

// ML related
#include <TensorFlowLite.h>
#include <tensorflow/lite/micro/all_ops_resolver.h>
#include <tensorflow/lite/micro/micro_error_reporter.h>
#include <tensorflow/lite/micro/micro_interpreter.h>
#include <tensorflow/lite/schema/schema_generated.h>
#include <tensorflow/lite/version.h>

// import the model
#include "model.h"



// audio data parameters, taken from the imported model.h file, written there from the Python-side UI
static constexpr unsigned int NUM_OF_SAMPLES_PER_TRACK = expected_duration * sample_rate;


// define the required buffers
// storageBuffer: this is where we store the raw microphone data, this is where we read into from the internal PDM buffer, which is of equal size
// sampleBuffer: we keep an entire audio_track worth of data in this buffer, so the length is NUM_OF_SAMPLES_PER_TRACK, as defined above
static const unsigned int SAMPLE_BUFFER_SIZE = NUM_OF_SAMPLES_PER_TRACK;
static const int PDM_BUFFER_SIZE = 512;
static const int PDM_BUFFER_SIZE_BYTES = PDM_BUFFER_SIZE * sizeof(short); // each sample is 2 bytes
static const int STORAGE_BUFFER_SIZE = PDM_BUFFER_SIZE; // equal to PDM buffer size
short sampleBuffer [SAMPLE_BUFFER_SIZE] = {0};
short storageBuffer [STORAGE_BUFFER_SIZE] = {0};


//short inputBuffer[] = {13, 18, 21, 21, 21, 23, 26, 27, 26, 25, 26, 28, 28,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 -20, -19};// define parameters for determining whether someone has spoken
// determined by comparing the mean square value of part of the
// sampleBuffer to a predefined, experimentally-found threshold 
volatile float meanSquare = 0.0;
volatile bool audioIsLoud = false;
static const float THRESHOLD = 40.0;
bool corruptedBuffer = false;
int corruptionCounter = 0;
volatile int samplesRead;


// define FFT-related parameters
uint32_t ifftFlag = 0;
arm_rfft_fast_instance_f32 varInstFastRfftF32;
unsigned short FRAME_LEN = window_size_samples;
static const unsigned short NUM_OF_FRAMES = (NUM_OF_SAMPLES_PER_TRACK - window_size_samples) / ((float) window_stride_samples) + 1;
const int CORRECT_FFT_SIZE = 1 + window_size_samples / 2;



// define tensorflow-related parameters
tflite::MicroErrorReporter tflErrorReporter;
// pull in all the TFLM ops, you can remove this line and
// only pull in the TFLM ops you need, if would like to reduce
// the compiled size of the sketch.
tflite::AllOpsResolver tflOpsResolver;

const tflite::Model* tflModel = nullptr;
tflite::MicroInterpreter* tflInterpreter = nullptr;
TfLiteTensor* tflInputTensor = nullptr;
TfLiteTensor* tflOutputTensor = nullptr;

// Create a static memory buffer for TFLM, the size may need to
// be adjusted based on the model you are using
constexpr unsigned long tensorArenaSize = 100 * 1024;
byte tensorArena[tensorArenaSize];



// function to calculate RMS given a source buffer as well as its size
float rms(float * source, const int source_length){
  float sum = 0;
  for (int i = 0; i < source_length; i++){
    sum += source[i] * source[i];
  }
  return sqrt(sum / ((float) source_length));
}



// main processing function
void processing(){

  if (processing_method == "none"){
    int avg_num = 32;
    for (int i = 0; i < NUM_OF_SAMPLES_PER_TRACK; i += avg_num){
      float avg = 0;
      for (int j = 0; j < avg_num; j++){
        if (i + j < NUM_OF_SAMPLES_PER_TRACK){
          avg += sampleBuffer[i + j];  
        }
        else{
          break;
        }
      }
      tflInputTensor->data.f[i / avg_num] = avg / ((float) avg_num);
    }
    return;
  }
  
  float windowBuffer [window_size_samples];
  float32_t fftBuffer [window_size_samples];
  
  for (int i = 0; i < NUM_OF_SAMPLES_PER_TRACK; i += window_stride_samples){
    if (i + window_size_samples >= NUM_OF_SAMPLES_PER_TRACK){
      return;
    }
    for (int j = 0; j < window_size_samples; j++){
      windowBuffer[j] = (float) sampleBuffer[i + j];
    }
    if (processing_method == "rms"){
      tflInputTensor->data.f[i / window_stride_samples] = rms(windowBuffer, window_size_samples);
    }
    else{
      arm_rfft_fast_f32(&varInstFastRfftF32, windowBuffer, fftBuffer, ifftFlag);
      for (int j = 0; j < CORRECT_FFT_SIZE; j++){
        if (j == 0){
          tflInputTensor->data.f[(i / window_stride_samples) * CORRECT_FFT_SIZE] = abs(fftBuffer[0]);
        }
        else if (j == window_size_samples / 2){
          tflInputTensor->data.f[(i / window_stride_samples) * CORRECT_FFT_SIZE + j] = abs(fftBuffer[1]);
        }
        else{
          tflInputTensor->data.f[(i / window_stride_samples) * CORRECT_FFT_SIZE + j] = sqrt(fftBuffer[2 * j] * fftBuffer[2 * j] + fftBuffer[2 * j + 1] * fftBuffer[2 * j + 1]);
        }
      }
    }
  }
}



// Callback function to process the data from the PDM microphone.
// Part of an Interrupt Service Routine (ISR)
void microphone_callback() {
  // Query the number of available bytes
  int bytesAvailable = PDM.available();
  
  // 16-bit, 2 bytes per sample
  samplesRead = bytesAvailable / sizeof(sampleBuffer[0]);

  // Read into the storage buffer  
  PDM.read(storageBuffer, samplesRead * sizeof(sampleBuffer[0]));
}



// function which runs inference on the defined model based on
// what has been stored in the tflInputTensor by the processing function
void run_inference(){
  // Run inferencing
  TfLiteStatus invokeStatus = tflInterpreter->Invoke();
  if (invokeStatus != kTfLiteOk) {
    Serial.println("Invoke failed!");
    while (1);
    return;
  }

  // Loop through the output tensor values from the model
  unsigned short argmax = 0;
  float mx = 0;
  for (unsigned short i = 0; i < NUM_RESPONSES; i++) {
    //Serial.print(RESPONSES[i]);
    //Serial.print(": ");
    //Serial.println(tflOutputTensor->data.f[i]);
    if (tflOutputTensor->data.f[i] > mx){
      mx = tflOutputTensor->data.f[i];
      argmax = i;
    }
  }
  Serial.println(RESPONSES[argmax]);
}



// setup
void setup() {
  Serial.begin(9600);
  while (!Serial);

  PDM.setBufferSize(PDM_BUFFER_SIZE_BYTES);
  
  // Configure the data receive callback
  PDM.onReceive(microphone_callback);

  // 0 gain works best for audio quality
  PDM.setGain(10);

  // Initialize PDM with:
  // - one channel (mono mode)
  // - a 16 kHz sample rate for the Arduino Nano 33 BLE Sense
  if (!PDM.begin(1, sample_rate)) {
    Serial.println("Failed to start PDM!");
    while (1);
  }

  arm_status status;
  status = arm_rfft_fast_init_f32 (&varInstFastRfftF32, window_size_samples);
  if (ARM_MATH_SUCCESS != status) {
    Serial.println("FFT length not supported!");
  }

  // get the TFL representation of the model byte array
  tflModel = tflite::GetModel(model_tflite);
  if (tflModel->version() != TFLITE_SCHEMA_VERSION) {
    Serial.println("Model schema mismatch!");
    while (1);
  }

  // Create an interpreter to run the model
  tflInterpreter = new tflite::MicroInterpreter(tflModel, tflOpsResolver, tensorArena, tensorArenaSize, &tflErrorReporter);

  // Allocate memory for the model's input and output tensors
  tflInterpreter->AllocateTensors();

  // Get pointers for the model's input and output tensors
  tflInputTensor = tflInterpreter->input(0);
  tflOutputTensor = tflInterpreter->output(0);
  delay(2000);
}



// loop
void loop() {
  // Wait for samples to be read
  if (samplesRead) {

    // Serial.println(samplesRead);
    // shift values from samplesRead to SAMPLE_BUFFER_SIZE to the range 0 to SAMPLE_BUFFER_SIZE - samplesRead
    memmove(&sampleBuffer[0], &sampleBuffer[samplesRead], (SAMPLE_BUFFER_SIZE - samplesRead) * sizeof(sampleBuffer[0]));
    // write the samplesRead from the storageBuffer to the end of the sampleBuffer
    memmove(&sampleBuffer[SAMPLE_BUFFER_SIZE - samplesRead], &storageBuffer[0], samplesRead * sizeof(sampleBuffer[0]));

    if (corruptedBuffer) {
      corruptionCounter -= samplesRead;
      if (corruptionCounter <= 0) {
        corruptedBuffer = false;
        Serial.println("Speak now");
      }
    }


    if (!corruptedBuffer) {
      meanSquare = 0.0;
      for (unsigned short i = 0; i < SAMPLE_BUFFER_SIZE /4; i++) {
        meanSquare += (sampleBuffer[i] * sampleBuffer[i]) / ((float) SAMPLE_BUFFER_SIZE);
      }
      audioIsLoud = (meanSquare > THRESHOLD);  
    }


    if (audioIsLoud && !corruptedBuffer) {
      // simulated_inference();
      // Serial.print(sizeof(sampleBuffer));
      //Serial.write((uint8_t*) sampleBuffer, SAMPLE_BUFFER_SIZE * sizeof(sampleBuffer[0]));
      processing();
      run_inference();
      corruptedBuffer = true;
      corruptionCounter = SAMPLE_BUFFER_SIZE;
    }

    // send the final samplesRead number of samples from the sampleBuffer
    // Serial.write((uint8_t*) &sampleBuffer[SAMPLE_BUFFER_SIZE - samplesRead], samplesRead * sizeof(sampleBuffer[0]));

    // Clear the read count
    samplesRead = 0;
  }
  
}
